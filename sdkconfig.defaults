## sdkconfig.defaults
```kconfig
# ===== Target =====
CONFIG_IDF_TARGET="esp32s3"
CONFIG_IDF_TARGET_ESP32S3=y

# ===== FreeRTOS / C++ =====
CONFIG_FREERTOS_HZ=1000
CONFIG_COMPILER_CXX_EXCEPTIONS=y

# ===== ESP32-S3 N8R8: 8 MB Flash + 8 MB Octal PSRAM =====
CONFIG_ESPTOOLPY_FLASHSIZE_8MB=y
CONFIG_SPIRAM=y
CONFIG_SPIRAM_MODE_OCT=y
CONFIG_SPIRAM_SPEED_80M=y
CONFIG_SPIRAM_USE_MALLOC=y
CONFIG_SPIRAM_MALLOC_ALWAYSINTERNAL=16384
CONFIG_SPIRAM_FETCH_INSTRUCTIONS=y
CONFIG_SPIRAM_RODATA=y
CONFIG_SPIRAM_XIP_FROM_PSRAM=y
CONFIG_ESP32S3_DATA_CACHE_LINE_64B=y

# ===== Partition table =====
CONFIG_PARTITION_TABLE_CUSTOM=y
CONFIG_PARTITION_TABLE_CUSTOM_FILENAME="partitions.csv"

# ===== Logging =====
CONFIG_LOG_DEFAULT_LEVEL_INFO=y
CONFIG_LOG_DEFAULT_LEVEL=3
CONFIG_ESP_CONSOLE_SECONDARY_NONE=y

# ===== Increase stack sizes =====
CONFIG_ESP_MAIN_TASK_STACK_SIZE=8192

# ===== I2S =====



CONFIG_LWIP_TCP_SND_BUF_DEFAULT=32768

CONFIG_LWIP_TCP_WND_DEFAULT=32768
```
